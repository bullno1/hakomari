## Config.in
```kconfig
source "$BR2_EXTERNAL_HAKOMARI_PATH/package/sinit/Config.in"
source "$BR2_EXTERNAL_HAKOMARI_PATH/package/hako/Config.in"
source "$BR2_EXTERNAL_HAKOMARI_PATH/package/hako/Config.in.host"
source "$BR2_EXTERNAL_HAKOMARI_PATH/package/cmp/Config.in"
source "$BR2_EXTERNAL_HAKOMARI_PATH/package/hakomari/Config.in"
source "$BR2_EXTERNAL_HAKOMARI_PATH/package/monero/Config.in"
source "$BR2_EXTERNAL_HAKOMARI_PATH/package/libancillary/Config.in"
source "$BR2_EXTERNAL_HAKOMARI_PATH/package/cpp-ethereum/Config.in"
```

## configs/rpi0_defconfig
```kconfig
BR2_arm=y
BR2_arm1176jzf_s=y
BR2_CCACHE=y
BR2_SSP_STRONG=y
BR2_GLOBAL_PATCH_DIR="$(BR2_EXTERNAL_HAKOMARI_PATH)/board/rpi0/patches"
BR2_PACKAGE_HOST_LINUX_HEADERS_CUSTOM_4_9=y
BR2_TOOLCHAIN_BUILDROOT_WCHAR=y
BR2_TOOLCHAIN_BUILDROOT_USE_SSP=y
BR2_BINUTILS_VERSION_2_29_X=y
BR2_GCC_VERSION_7_X=y
BR2_TOOLCHAIN_BUILDROOT_CXX=y
BR2_GCC_ENABLE_LTO=y
BR2_GCC_ENABLE_GRAPHITE=y
BR2_ROOTFS_MERGED_USR=y
BR2_TARGET_GENERIC_HOSTNAME="hakomari"
BR2_TARGET_GENERIC_ISSUE="Hakomari"
BR2_INIT_NONE=y
# BR2_TARGET_GENERIC_GETTY is not set
# BR2_TARGET_GENERIC_REMOUNT_ROOTFS_RW is not set
BR2_ROOTFS_OVERLAY="$(BR2_EXTERNAL_HAKOMARI_PATH)/board/rpi0/rootfs-overlay/"
BR2_ROOTFS_POST_BUILD_SCRIPT="$(BR2_EXTERNAL_HAKOMARI_PATH)/board/rpi0/post-build.sh"
BR2_ROOTFS_POST_IMAGE_SCRIPT="$(BR2_EXTERNAL_HAKOMARI_PATH)/board/rpi0/post-image.sh"
BR2_LINUX_KERNEL=y
BR2_LINUX_KERNEL_CUSTOM_GIT=y
BR2_LINUX_KERNEL_CUSTOM_REPO_URL="https://github.com/raspberrypi/linux.git"
BR2_LINUX_KERNEL_CUSTOM_REPO_VERSION="9126e25b0934bd7bd843763310ea4b34c6e139d0"
BR2_LINUX_KERNEL_USE_CUSTOM_CONFIG=y
BR2_LINUX_KERNEL_CUSTOM_CONFIG_FILE="$(BR2_EXTERNAL_HAKOMARI_PATH)/board/rpi0/linux.config"
BR2_LINUX_KERNEL_LZ4=y
BR2_LINUX_KERNEL_DTS_SUPPORT=y
BR2_LINUX_KERNEL_INTREE_DTS_NAME="bcm2708-rpi-b-plus bcm2708-rpi-0-w"
BR2_PACKAGE_BUSYBOX_CONFIG="$(BR2_EXTERNAL_HAKOMARI_PATH)/board/rpi0/busybox.config"
BR2_PACKAGE_RPI_FIRMWARE=y
BR2_PACKAGE_RNG_TOOLS=y
BR2_PACKAGE_GD=y
BR2_PACKAGE_C_PERIPHERY=y
BR2_PACKAGE_DROPBEAR=y
# BR2_PACKAGE_DROPBEAR_CLIENT is not set
BR2_PACKAGE_DROPBEAR_DISABLE_REVERSEDNS=y
# BR2_PACKAGE_IFUPDOWN_SCRIPTS is not set
BR2_PACKAGE_RSYNC=y
BR2_TARGET_ROOTFS_EXT2=y
BR2_TARGET_ROOTFS_EXT2_4=y
BR2_TARGET_ROOTFS_EXT2_SIZE="32M"
# BR2_TARGET_ROOTFS_TAR is not set
BR2_PACKAGE_HOST_DOSFSTOOLS=y
BR2_PACKAGE_HOST_GENIMAGE=y
BR2_PACKAGE_HOST_MTOOLS=y
BR2_PACKAGE_SINIT=y
BR2_PACKAGE_HAKO=y
BR2_PACKAGE_HOST_HAKO=y
BR2_PACKAGE_CMP=y
BR2_PACKAGE_HAKOMARI=y
```

## package/cmp/Config.in
```kconfig
config BR2_PACKAGE_CMP
	bool "cmp"
	help
	  An implementation of the MessagePack serialization format in C

	  https://github.com/camgunz/cmp
```

## package/cpp-ethereum/Config.in
```kconfig
config BR2_PACKAGE_CPP_ETHEREUM
	bool "cpp-ethereum"
	select BR2_PACKAGE_LEVELDB
	help
	  The Ethereum C++ client.

	  http://cpp-ethereum.org/
```

## package/geth/Config.in
```kconfig
config BR2_PACKAGE_GETH
	bool "geth"
	select BR2_PACKAGE_HOST_GO_ARCH_SUPPORTS
	select BR2_UCLIBC_OVERRIDE
	help
	  Official Go implementation of the Ethereum protocol.

	  https://geth.ethereum.org/
```

## package/hako/Config.in
```kconfig
config BR2_PACKAGE_HAKO
	bool "hako"
	help
	  A minimal sandboxing tool.

	  https://github.com/bullno1/hako
```

## package/hako/Config.in.host
```kconfig
config BR2_PACKAGE_HOST_HAKO
	bool "host hako"
	help
	  A minimal sandboxing tool.

	  https://github.com/bullno1/hako
```

## package/hakomari-providers/Config.in
```kconfig
config BR2_PACKAGE_HAKOMARI_PROVIDERS
	bool "hakomari-providers"
	select BR2_PACKAGE_HAKOMARI
	help
	  Providers for Hakomari.

	  https://github.com/bullno1/hakomari

if BR2_PACKAGE_HAKOMARI_PROVIDERS

config BR2_PACKAGE_HAKOMARI_PROVIDERS_ETH
	bool "hakomari-providers-eth"
	select BR2_PACKAGE_CPP_ETHEREUM
	help
	  Support for Ethereum

endif
```

## package/hakomari/Config.in
```kconfig
config BR2_PACKAGE_HAKOMARI
	bool "hakomari"
	select BR2_PACKAGE_C_PERIPHERY
	select BR2_PACKAGE_GD
	select BR2_PACKAGE_CMP
	select BR2_PACKAGE_LIBANCILLARY
	select BR2_PACKAGE_HAKO
	help
	  Wallet daemons.

	  https://github.com/bullno1/hakomari
```

## package/jchroot/Config.in
```kconfig
config BR2_PACKAGE_JCHROOT
	bool "jchroot"
	help
	  A chroot with more isolation.

	  https://github.com/vincentbernat/jchroot
```

## package/jchroot/Config.in.host
```kconfig
config BR2_PACKAGE_HOST_JCHROOT
	bool "host jchroot"
	help
	  A chroot with more isolation.

	  https://github.com/vincentbernat/jchroot
```

## package/libancillary/Config.in
```kconfig
config BR2_PACKAGE_LIBANCILLARY
	bool "libancillary"
	help
	  This library provide an easy interface to the black magic that
	  can be done on Unix domain sockets, like passing file
	  descriptors from one process to another.

	  https://www.normalesup.org/~george/comp/libancillary/
```

## package/monero/Config.in
```kconfig
config BR2_PACKAGE_MONERO
	bool "monero"
	select BR2_PACKAGE_BOOST
	select BR2_PACKAGE_BOOST_SYSTEM
	select BR2_PACKAGE_BOOST_FILESYSTEM
	select BR2_PACKAGE_BOOST_THREAD
	select BR2_PACKAGE_BOOST_DATE_TIME
	select BR2_PACKAGE_BOOST_CHRONO
	select BR2_PACKAGE_BOOST_REGEX
	select BR2_PACKAGE_BOOST_SERIALIZATION
	select BR2_PACKAGE_BOOST_PROGRAM_OPTIONS
	select BR2_PACKAGE_OPENSSL
	select BR2_PACKAGE_CPPZMQ
	help
	  Monero: the secure, private, untraceable cryptocurrency.

	  https://getmonero.org/
```

## package/sinit/Config.in
```kconfig
config BR2_PACKAGE_SINIT
	bool "sinit"
	help
	  sinit is a suckless init, initially based on Rich Felker's
	  minimal init.

	  https://core.suckless.org/sinit
```

## package/uclibc-override/Config.in
```kconfig
if BR2_TOOLCHAIN_BUILDROOT_UCLIBC

config BR2_UCLIBC_OVERRIDE
	bool "uclibc-override"
	help
	  Horrible hack to force uclibc to build dynamic library.

endif
```
